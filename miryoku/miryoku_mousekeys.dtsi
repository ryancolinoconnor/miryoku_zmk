// Copyright 2022 Manna Harbour
// https://github.com/manna-harbour/miryoku
/*
&mmv {
  acceleration-exponent = <U_MOUSE_MOVE_EXPONENT>;
  time-to-max-speed-ms = <U_MOUSE_MOVE_TIME>;
  delay-ms = <U_MOUSE_MOVE_DELAY>;
};
*/
&mmv {
        acceleration-exponent = <1>;
        time-to-max-speed-ms = <80>;
        delay-ms = <0>;
        trigger-period-ms = <8>;
};
/*

&msc {
  acceleration-exponent = <U_MOUSE_SCROLL_EXPONENT>;
  time-to-max-speed-ms = <U_MOUSE_SCROLL_TIME>;
  delay-ms = <U_MOUSE_SCROLL_DELAY>;
};

*/
&msc {
  acceleration-exponent = <1>;
  time-to-max-speed-ms = <40>;
  delay-ms = <0>;
 trigger-period-ms = <8>;
};
