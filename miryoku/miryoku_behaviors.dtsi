// Copyright 2022 Manna Harbour
// https://github.com/manna-harbour/miryoku

#define U_MOUSE_MOVE 3400

#define U_MS_U &mmv MOVE_Y(-U_MOUSE_MOVE)
#define U_MS_D &mmv MOVE_Y(U_MOUSE_MOVE)
#define U_MS_L &mmv MOVE_X(-U_MOUSE_MOVE)
#define U_MS_R &mmv MOVE_X(U_MOUSE_MOVE)

/ {
  behaviors {
    u_mt: u_mt {
      compatible = "zmk,behavior-hold-tap";
      #binding-cells = <2>;
      tapping-term-ms = <U_TAPPING_TERM>;
      flavor = "tap-preferred";
      bindings = <&kp>, <&kp>;
    };
    u_lt: u_lt {
      compatible = "zmk,behavior-hold-tap";
      #binding-cells = <2>;
      tapping-term-ms = <U_TAPPING_TERM>;
      flavor = "tap-preferred";
      bindings = <&mo>, <&kp>;
    };
  };
};
